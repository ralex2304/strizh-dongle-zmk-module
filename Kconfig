## Kconfig
```kconfig
config STRIZH_DONGLE_LAYER_ROLLER_ALL_CAPS
    bool "Convert layer names to all caps"
    default n

config STRIZH_DONGLE_ROTATE_DISPLAY_180
    bool "Rotate the display 180 degrees"
    default n

config STRIZH_DONGLE_USE_AMBIENT_LIGHT_SENSOR
    bool "Use ambient light sensor for auto brightness"
    default n

config STRIZH_DONGLE_FIXED_BRIGHTNESS
    int "Fixed display brightness"
    default 50
    range 1 100
    depends on !STRIZH_DONGLE_USE_AMBIENT_LIGHT_SENSOR
```

## boards/shields/strizh_dongle_adapter/Kconfig.shield
```kconfig
config SHIELD_STRIZH_DONGLE_ADAPTER
    def_bool $(shields_list_contains,strizh_dongle_adapter)
```
